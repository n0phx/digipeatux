## external/Config.in
```kconfig
menu "System configuration"

	config DPT_CONF_PARTITION_SIZE
		int "Size of the partition for configuration files in MiB"
		default 64
		help
			The root filesystem is unpacked into RAM and mounted
			rw, but it's volatile, and all the changes are lost
			after rebooting the system. For this reason a separate
			partition is used for non-volatile storage of important
			configuration files.

	config DPT_DATA_PARTITION_SIZE
		int "Size of the partition for arbitrary data files in MiB"
		default 64
		help
			The root filesystem is unpacked into RAM and mounted
			rw, but it's volatile, and all the changes are lost
			after rebooting the system. For this reason a separate
			partition is used for non-volatile storage of arbitrary
			data files (such as log files, databases, ...).

endmenu

menu "Applications"
	source "$BR2_EXTERNAL_CUSTOM_PATH/package/aprx/Config.in"
	source "$BR2_EXTERNAL_CUSTOM_PATH/package/ax25-apps/Config.in"
	source "$BR2_EXTERNAL_CUSTOM_PATH/package/ax25-tools/Config.in"
	source "$BR2_EXTERNAL_CUSTOM_PATH/package/libax25/Config.in"
	source "$BR2_EXTERNAL_CUSTOM_PATH/package/soundmodem/Config.in"
endmenu
```

## external/configs/rpi2_defconfig
```kconfig
BR2_arm=y
BR2_cortex_a7=y
BR2_ARM_EABIHF=y
BR2_ARM_FPU_NEON_VFPV4=y
BR2_PACKAGE_HOST_LINUX_HEADERS_CUSTOM_5_10=y
BR2_TOOLCHAIN_BUILDROOT_WCHAR=y
BR2_TOOLCHAIN_BUILDROOT_CXX=y
BR2_TARGET_GENERIC_HOSTNAME="digipeatux"
BR2_TARGET_GENERIC_ISSUE="Welcome to digipeatux"
BR2_ROOTFS_DEVICE_TABLE="system/device_table.txt $(BR2_EXTERNAL_CUSTOM_PATH)/configs/device_table.txt"
# BR2_TARGET_GENERIC_GETTY is not set
BR2_SYSTEM_DHCP="eth0"
BR2_TARGET_TZ_INFO=y
BR2_ROOTFS_USERS_TABLES="$(BR2_EXTERNAL_CUSTOM_PATH)/configs/users_table.txt"
BR2_ROOTFS_OVERLAY="$(BR2_EXTERNAL_CUSTOM_PATH)/rootfs_overlay/common"
BR2_ROOTFS_POST_BUILD_SCRIPT="$(BR2_EXTERNAL_CUSTOM_PATH)/scripts/patch-fstab.sh $(BR2_EXTERNAL_CUSTOM_PATH)/scripts/save-version.sh"
BR2_ROOTFS_POST_IMAGE_SCRIPT="$(BR2_EXTERNAL_CUSTOM_PATH)/scripts/post-image.sh"
BR2_ROOTFS_POST_SCRIPT_ARGS="$(BR2_EXTERNAL_CUSTOM_PATH)/board/rpi2/genimage.cfg $(DPT_CONF_PARTITION_SIZE) $(DPT_DATA_PARTITION_SIZE)"
BR2_LINUX_KERNEL=y
BR2_LINUX_KERNEL_CUSTOM_TARBALL=y
BR2_LINUX_KERNEL_CUSTOM_TARBALL_LOCATION="$(call github,raspberrypi,linux,0b54dbda3cca2beb51e236a25738784e90853b64)/linux-0b54dbda3cca2beb51e236a25738784e90853b64.tar.gz"
BR2_LINUX_KERNEL_USE_CUSTOM_CONFIG=y
BR2_LINUX_KERNEL_CUSTOM_CONFIG_FILE="$(BR2_EXTERNAL_CUSTOM_PATH)/board/rpi2/kernel.config"
BR2_LINUX_KERNEL_DTS_SUPPORT=y
BR2_LINUX_KERNEL_INTREE_DTS_NAME="bcm2709-rpi-2-b"
BR2_LINUX_KERNEL_NEEDS_HOST_OPENSSL=y
BR2_PACKAGE_BUSYBOX_CONFIG="$(BR2_EXTERNAL_CUSTOM_PATH)/configs/busybox.config"
BR2_PACKAGE_BUSYBOX_SHOW_OTHERS=y
BR2_PACKAGE_ALSA_UTILS=y
BR2_PACKAGE_ALSA_UTILS_ALSACONF=y
BR2_PACKAGE_ALSA_UTILS_AMIXER=y
BR2_PACKAGE_ALSA_UTILS_APLAY=y
BR2_PACKAGE_BIND=y
BR2_PACKAGE_BIND_TOOLS=y
BR2_PACKAGE_NTP=y
BR2_PACKAGE_NTP_NTPD=y
BR2_PACKAGE_RPI_FIRMWARE=y
BR2_PACKAGE_RPI_FIRMWARE_BOOTCODE_BIN=y
BR2_PACKAGE_RPI_FIRMWARE_VARIANT_PI=y
BR2_PACKAGE_RPI_FIRMWARE_CONFIG_FILE="board/raspberrypi/config_default.txt"
# BR2_PACKAGE_RPI_FIRMWARE_INSTALL_DTB_OVERLAYS is not set
BR2_PACKAGE_LIBXML2=y
BR2_PACKAGE_GNURADIO=y
BR2_PACKAGE_GR_OSMOSDR=y
BR2_PACKAGE_GR_OSMOSDR_RTLSDR=y
BR2_PACKAGE_DROPBEAR=y
BR2_PACKAGE_SUDO=y
BR2_PACKAGE_MONIT=y
BR2_PACKAGE_NETCAT=y
BR2_PACKAGE_UTIL_LINUX=y
BR2_PACKAGE_UTIL_LINUX_BINARIES=y
BR2_PACKAGE_NANO=y
BR2_TARGET_ROOTFS_EXT2=y
BR2_TARGET_ROOTFS_EXT2_4=y
BR2_TARGET_ROOTFS_EXT2_SIZE="100M"
BR2_TARGET_ROOTFS_INITRAMFS=y
# BR2_TARGET_ROOTFS_TAR is not set
BR2_PACKAGE_HOST_DOSFSTOOLS=y
BR2_PACKAGE_HOST_GENEXT2FS=y
BR2_PACKAGE_HOST_GENIMAGE=y
BR2_PACKAGE_HOST_MTOOLS=y
BR2_PACKAGE_APRX=y
BR2_PACKAGE_AX25_APPS=y
BR2_PACKAGE_AX25_TOOLS=y
BR2_PACKAGE_DIREWOLF=y
```

## external/configs/rpi3_defconfig
```kconfig
BR2_arm=y
BR2_cortex_a53=y
BR2_ARM_FPU_NEON_VFPV4=y
BR2_PACKAGE_HOST_LINUX_HEADERS_CUSTOM_5_10=y
BR2_TOOLCHAIN_BUILDROOT_WCHAR=y
BR2_TOOLCHAIN_BUILDROOT_CXX=y
BR2_TARGET_GENERIC_HOSTNAME="digipeatux"
BR2_TARGET_GENERIC_ISSUE="Welcome to digipeatux"
BR2_ROOTFS_DEVICE_TABLE="system/device_table.txt $(BR2_EXTERNAL_CUSTOM_PATH)/configs/device_table.txt"
# BR2_TARGET_GENERIC_GETTY is not set
BR2_SYSTEM_DHCP="eth0"
BR2_TARGET_TZ_INFO=y
BR2_ROOTFS_USERS_TABLES="$(BR2_EXTERNAL_CUSTOM_PATH)/configs/users_table.txt"
BR2_ROOTFS_OVERLAY="$(BR2_EXTERNAL_CUSTOM_PATH)/rootfs_overlay/common"
BR2_ROOTFS_POST_BUILD_SCRIPT="board/raspberrypi/post-build.sh $(BR2_EXTERNAL_CUSTOM_PATH)/scripts/patch-fstab.sh $(BR2_EXTERNAL_CUSTOM_PATH)/scripts/save-version.sh"
BR2_ROOTFS_POST_IMAGE_SCRIPT="$(BR2_EXTERNAL_CUSTOM_PATH)/scripts/post-image.sh"
BR2_ROOTFS_POST_SCRIPT_ARGS="$(BR2_EXTERNAL_CUSTOM_PATH)/board/rpi3/genimage.cfg $(DPT_CONF_PARTITION_SIZE) $(DPT_DATA_PARTITION_SIZE)"
BR2_LINUX_KERNEL=y
BR2_LINUX_KERNEL_CUSTOM_TARBALL=y
BR2_LINUX_KERNEL_CUSTOM_TARBALL_LOCATION="$(call github,raspberrypi,linux,0b54dbda3cca2beb51e236a25738784e90853b64)/linux-0b54dbda3cca2beb51e236a25738784e90853b64.tar.gz"
BR2_LINUX_KERNEL_USE_CUSTOM_CONFIG=y
BR2_LINUX_KERNEL_CUSTOM_CONFIG_FILE="$(BR2_EXTERNAL_CUSTOM_PATH)/board/rpi3/kernel.config"
BR2_LINUX_KERNEL_DTS_SUPPORT=y
BR2_LINUX_KERNEL_INTREE_DTS_NAME="bcm2710-rpi-3-b bcm2710-rpi-3-b-plus bcm2710-rpi-cm3"
BR2_LINUX_KERNEL_NEEDS_HOST_OPENSSL=y
BR2_PACKAGE_BUSYBOX_CONFIG="$(BR2_EXTERNAL_CUSTOM_PATH)/configs/busybox.config"
BR2_PACKAGE_ALSA_UTILS=y
BR2_PACKAGE_ALSA_UTILS_ALSACONF=y
BR2_PACKAGE_ALSA_UTILS_AMIXER=y
BR2_PACKAGE_ALSA_UTILS_APLAY=y
BR2_PACKAGE_RPI_FIRMWARE=y
BR2_PACKAGE_RPI_FIRMWARE_BOOTCODE_BIN=y
BR2_PACKAGE_RPI_FIRMWARE_VARIANT_PI=y
BR2_PACKAGE_RPI_FIRMWARE_CONFIG_FILE="board/raspberrypi3/config_3.txt"
BR2_PACKAGE_DROPBEAR=y
BR2_PACKAGE_SUDO=y
BR2_PACKAGE_MONIT=y
BR2_PACKAGE_UTIL_LINUX=y
BR2_PACKAGE_UTIL_LINUX_BINARIES=y
BR2_PACKAGE_NANO=y
BR2_TARGET_ROOTFS_EXT2=y
BR2_TARGET_ROOTFS_EXT2_4=y
BR2_TARGET_ROOTFS_EXT2_SIZE="90M"
BR2_TARGET_ROOTFS_INITRAMFS=y
# BR2_TARGET_ROOTFS_TAR is not set
BR2_PACKAGE_HOST_DOSFSTOOLS=y
BR2_PACKAGE_HOST_GENEXT2FS=y
BR2_PACKAGE_HOST_GENIMAGE=y
BR2_PACKAGE_HOST_MTOOLS=y
BR2_PACKAGE_APRX=y
BR2_PACKAGE_AX25_APPS=y
BR2_PACKAGE_AX25_TOOLS=y
```

## external/configs/rpi_defconfig
```kconfig
BR2_arm=y
BR2_arm1176jzf_s=y
BR2_ARM_EABIHF=y
BR2_PACKAGE_HOST_LINUX_HEADERS_CUSTOM_4_14=y
BR2_TOOLCHAIN_BUILDROOT_WCHAR=y
BR2_TOOLCHAIN_BUILDROOT_CXX=y
BR2_TARGET_GENERIC_HOSTNAME="digipeatux"
BR2_TARGET_GENERIC_ISSUE="Welcome to digipeatux"
BR2_ROOTFS_DEVICE_TABLE="system/device_table.txt $(BR2_EXTERNAL_CUSTOM_PATH)/configs/device_table.txt"
# BR2_TARGET_GENERIC_GETTY is not set
BR2_SYSTEM_DHCP="eth0"
BR2_TARGET_TZ_INFO=y
BR2_ROOTFS_USERS_TABLES="$(BR2_EXTERNAL_CUSTOM_PATH)/configs/users_table.txt"
BR2_ROOTFS_OVERLAY="$(BR2_EXTERNAL_CUSTOM_PATH)/rootfs_overlay/common"
BR2_ROOTFS_POST_BUILD_SCRIPT="$(BR2_EXTERNAL_CUSTOM_PATH)/scripts/patch-fstab.sh $(BR2_EXTERNAL_CUSTOM_PATH)/scripts/save-version.sh"
BR2_ROOTFS_POST_IMAGE_SCRIPT="$(BR2_EXTERNAL_CUSTOM_PATH)/scripts/post-image.sh"
BR2_ROOTFS_POST_SCRIPT_ARGS="$(BR2_EXTERNAL_CUSTOM_PATH)/board/rpi/genimage.cfg $(DPT_CONF_PARTITION_SIZE) $(DPT_DATA_PARTITION_SIZE)"
BR2_LINUX_KERNEL=y
BR2_LINUX_KERNEL_CUSTOM_TARBALL=y
BR2_LINUX_KERNEL_CUSTOM_TARBALL_LOCATION="$(call github,raspberrypi,linux,83b36f98e1a48d143f0b466fcf9f8c4e382c9a1c)/linux-83b36f98e1a48d143f0b466fcf9f8c4e382c9a1c.tar.gz"
BR2_LINUX_KERNEL_USE_CUSTOM_CONFIG=y
BR2_LINUX_KERNEL_CUSTOM_CONFIG_FILE="$(BR2_EXTERNAL_CUSTOM_PATH)/board/rpi/kernel.config"
BR2_LINUX_KERNEL_DTS_SUPPORT=y
BR2_LINUX_KERNEL_INTREE_DTS_NAME="bcm2708-rpi-b bcm2708-rpi-b-plus bcm2708-rpi-cm"
BR2_PACKAGE_BUSYBOX_CONFIG="$(BR2_EXTERNAL_CUSTOM_PATH)/configs/busybox.config"
BR2_PACKAGE_ALSA_UTILS=y
BR2_PACKAGE_ALSA_UTILS_ALSACONF=y
BR2_PACKAGE_ALSA_UTILS_AMIXER=y
BR2_PACKAGE_ALSA_UTILS_APLAY=y
BR2_PACKAGE_RPI_FIRMWARE=y
# BR2_PACKAGE_RPI_FIRMWARE_INSTALL_DTB_OVERLAYS is not set
BR2_PACKAGE_DROPBEAR=y
BR2_PACKAGE_SUDO=y
BR2_PACKAGE_MONIT=y
BR2_PACKAGE_UTIL_LINUX=y
BR2_PACKAGE_UTIL_LINUX_BINARIES=y
BR2_PACKAGE_NANO=y
BR2_TARGET_ROOTFS_EXT2=y
BR2_TARGET_ROOTFS_EXT2_4=y
BR2_TARGET_ROOTFS_EXT2_SIZE="90M"
BR2_TARGET_ROOTFS_INITRAMFS=y
# BR2_TARGET_ROOTFS_TAR is not set
BR2_PACKAGE_HOST_DOSFSTOOLS=y
BR2_PACKAGE_HOST_GENEXT2FS=y
BR2_PACKAGE_HOST_GENIMAGE=y
BR2_PACKAGE_HOST_MTOOLS=y
BR2_PACKAGE_APRX=y
BR2_PACKAGE_AX25_APPS=y
BR2_PACKAGE_AX25_TOOLS=y
```

## external/package/aprx/Config.in
```kconfig
config BR2_PACKAGE_APRX
	bool "aprx"
	help
	  APRS i-gate / digipeater

	  aprx is for amateur radio APRS networking. It has a very small memory
	  footprint, and integrates nicely with AX.25 devices.

if BR2_PACKAGE_APRX

config BR2_APRX_CONFIG_PATH
	string "Path to the aprx configuration file"
	default "/etc/aprx.conf"
	help
	  The init script will explicitly reference this path when starting
	  the soundmodem service.

endif # BR2_PACKAGE_APRX
```

## external/package/ax25-apps/Config.in
```kconfig
config BR2_PACKAGE_AX25_APPS
	bool "ax25-apps"
	select BR2_PACKAGE_LIBAX25
	select BR2_PACKAGE_NCURSES
	help
	  This package provides specific user applications for hamradio that
	  use AX.25 Net/ROM or ROSE network protocols:

	  - axcall: a general purpose AX.25, NET/ROM and ROSE connection program.
	  - axlisten: a network monitor of all AX.25 traffic heard by the system.
	  - ax25ipd: an RFC1226 compliant daemon which provides encapsulation of
	    AX.25 traffic over IP.
	  - ax25mond: retransmits data received from sockets into an AX.25
	    monitor socket.
```

## external/package/ax25-tools/Config.in
```kconfig
config BR2_PACKAGE_AX25_TOOLS
	bool "ax25-tools"
	select BR2_PACKAGE_LIBAX25
	select BR2_PACKAGE_NCURSES
	select BR2_PACKAGE_ZLIB
	help
	  These are hamradio specific tools for setting up and configuring hamradio
	  ports that use AX.25 Net/ROM or ROSE network protocols. 
```

## external/package/direwolf/Config.in
```kconfig
config BR2_PACKAGE_DIREWOLF
        bool "direwolf"
        select BR2_PACKAGE_ALSA_LIB
        help
          Dire Wolf is a software "soundcard" AX.25 packet modem/TNC
          and APRS encoder/decoder.

          https://github.com/wb2osz/direwolf/

if BR2_PACKAGE_DIREWOLF

config BR2_DIREWOLF_BUILD_WITH_NEON
	bool "Build with NEON vector instructions"
	help
	  Direwolf doesn't autodetect NEON support correctly when cross-compiling.
	  For Raspberry Pi 1, this is a problem, as it will enable NEON instructions
	  even though the RPi1 CPU doesn't support them.

endif # BR2_PACKAGE_DIREWOLF
```

## external/package/libax25/Config.in
```kconfig
config BR2_PACKAGE_LIBAX25
	bool "libax25"
	help
	  libax25 is a library containing a set of functions making it easier
	  to write hamradio programs. The functions cover most of the types of
	  hamradio address families (AX.25, ROSE & NET/ROM) as well as
	  understanding the hamradio port parameters in the config files.
```

## external/package/soundmodem/Config.in
```kconfig
config BR2_PACKAGE_SOUNDMODEM
	bool "soundmodem"
	select BR2_PACKAGE_ALSA_LIB
	select BR2_PACKAGE_AUDIOFILE
	select BR2_PACKAGE_LIBXML2
	help
	  Usermode Soundcard Modem driver

	  The source code is the latest available version on archive.org
	  Some patches were borrowed from the debian package (versioned as
	  0.20-5), while the rest were added mainly to allow
	  cross-compilation and to drop the dependency on gtk (which also
	  disables the gui configuration tool).

if BR2_PACKAGE_SOUNDMODEM

config BR2_SOUNDMODEM_CONFIG_PATH
	string "Path to the soundmodem configuration file"
	default "/etc/ax25/soundmodem.conf"
	help
	  The init script will explicitly reference this path when starting
	  the soundmodem service.

endif # BR2_PACKAGE_SOUNDMODEM
```
